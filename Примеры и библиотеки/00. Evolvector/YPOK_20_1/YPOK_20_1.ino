//Урок 20 (Робот)
#define button 2
#define fotodatchik A0
#define buzer 13
#define led 11
#define LCD 12
#define termo A1
#include <Servo.h>
#include "Ultrasonic.h"
Ultrasonic dalnomer(3, 4);
Servo dvig;
#include <LiquidCrystalRus.h>
LiquidCrystalRus lcd(10, 9, 8, 7, 6, 5);
int state, state2=0, foto,val, temp, regim=0, noch, i, iMem, num; 
float time, voltage, dist, distMem;

void setup() {
 lcd.begin(16, 2);
 pinMode(led, OUTPUT);
 pinMode(button, INPUT);
 pinMode(LCD, OUTPUT);
 dvig.attach(A2);
 randomSeed(analogRead(5)); // инициализация генератора случайных чисел
}

void loop(){
if (regim == 0) { regsleep();} //проверка значений переменной regim
if (regim == 1) { regnaidi();} // и в зависимости от того какое число на текущий момент
if (regim == 2) { reghello();} // ей присвоено, вызывается соответствующая функция 
if (regim == 3) { regwait();}
if (regim == 4) { regtemp();}
if (regim == 5) { regsudba();}
if (regim == 6) { reggame();}

foto = analogRead(fotodatchik); // считывание напряжения с фотодатчика
if (foto < 200) {noch = 1;}  // если освещенность меньше 200 единиц, то значит сейчас ночь
delay(200);}

void regsleep(){   // функция, выполняющая действия при режиме сна (ожидания) робота 
if (noch == 1){analogWrite(led, 255);}  // если сейчас ночь, то включается ночник в виде светодиода
else {analogWrite(led, 40);} // иначе (то есть если день), то светодиод светится тускло
digitalWrite(LCD, LOW); // отключается подсветка экрана
lcd.clear(); // очистка экрана
lcd.print("Режим сна"); // вывод на экран сообщения: Режим сна
state = digitalRead(button);  // считывается состояние кнопки
delay(200);
if (state == HIGH)  //если кнопка нажата, то выполняется переход в режим 3 (ожидание действий)
  {regim = 3; }
if (foto > 400 && noch == 1)  // если сейчас ночь и наступил рассвет, 
  {regim = 2; noch = 0;}} // то выполняется переход в режим 2 и обнуляется переменная ночь

void reghello(){ // пользовательская функция, выполняющая действия, при режиме просыпания
song(); // вызывается функция, воспроизводящая звуковой сигнал
analogWrite(led, 255); // включается на максимальную яркость светодиод
digitalWrite(LCD, HIGH); //включается подсветка экрана
lcd.clear(); // очистка экрана
lcd.print("Привет,"); // на экран выводится слово: Привет
lcd.setCursor(0, 1); // установка курсора на первый символ второй строки
lcd.print("пора просыпаться"); //вывод на экран фразы: пора просыпаться
delay (3000);
regim=3;}   // после просыпания робот сразу переходит в режим ожидания действий

void regwait(){ // пользовательская функция, управляющая роботом в режиме ожидания действий.
analogWrite(led, 255); // включается светодиод 
digitalWrite(LCD, HIGH); // включается подсветка экрана
lcd.clear();             // очистка экрана
lcd.print("Нажми кнопку для"); // вывод на экран фразы: Нажми кнопку для
lcd.setCursor(0, 1);           // установка курсора на первый символ второй строки
lcd.print("выбора режима");  // выводится на экран фраза: выбор режима
time= millis(); // засекается время
while(regim == 3){             // пока режим не поменялся, постоянно повторяется цикл 
  state = digitalRead(button); //считывается состояние кнопки
  delay(200);
  if (state == HIGH && state2 == 0) // если кнопка нажата и переменная state2 = 0 (то есть еще не задавался никакой режим), то  
    {regim = 4;}            // выполняется переход в режим 4 - измерение температуры
  if (state ==HIGH && state2==1)  // если state2=1 (означает, что измерение температуры уже прошло), выполняется переход в режим "найди меня"
    {regim = 1;}
  if (state ==HIGH && state2==2)  // если state2=2 (означает, что режим "найди меня" пройден), выполняется переход в режим "экран судьбы"
    {regim = 5;}
  if (state ==HIGH && state2==3)  // если state2=3 (означает, что режим "экран судьбы" пройден), выполняется переход к игре "скорость"
    {regim = 6;}
  if (millis() - time > 30000) // если возникла пауза более 30 секунд и пользователь не нажал на кнопку, то робот переходит в режим сна
    {regim = 0;}
  }}

void regtemp(){ // определяется функция, выполняющая действия в режиме измерения температуры
analogWrite(led, 0);
lcd.display(); // набор команд для выведения на экран фразы : Измерение температуры
lcd.clear();
lcd.print("Измерение");
lcd.setCursor(0, 1);
lcd.print("температуры");
delay (500);
digitalWrite(LCD, LOW); // выполняется отключение подсветки экрана, чтобы исключить просадку напряжения, искажающую температурные измерения
delay (500);
val = analogRead(termo);  // считывается напряжение с термодатчкика
voltage = (val*5.0/1023);
temp = voltage*100-273.15; // и вычиссляется реальная температура
digitalWrite(LCD, HIGH);
lcd.clear();       // команды для вывода на экран вычисленного значения температуры
lcd.print(temp);
lcd.setCursor(4, 0);
if (temp < 20)     // проверка уровня температуры - если меньше 20 градусов, то
  {lcd.print("Холодновато");  // на экрана выводятся фраза: Холодновато Включи обогрев
   lcd.setCursor(0, 1);
   lcd.print("Включи обогрев");}
if (temp > 20 && temp < 27)  // проверка уровня температуры - если больше 20 градусов, но меньше 27, то
  {lcd.print("То что надо");} // на экрана выводятся фраза: То, что надо
if (temp > 27) // если больше 27 градусов, то
  {lcd.print("Жара"); // выводится на экран фраза: Жара Охладите воздух
  lcd.setCursor(0, 1);
  lcd.print("Охладите воздух ");}
regim = 3; state2=1;    // после завершения функции переменной state2 присваивается единица, и робот переходит в режим ожидания  
delay (3000);}    

void regnaidi(){  // определение функции, отвечающей за игру "найди меня"
analogWrite(led, 0);     // выключается светодиод
digitalWrite(LCD, HIGH);  // Включается подсветка экрана
dvig.write(5);    // вал сервопривода устанавливается в начальное положение
distMem=5000;
lcd.display();  // набор команд для вывода на экран фразы: Ищу Ищу
lcd.clear();
lcd.print("Ищу Ищу");
for (i=5; i<=170; i=i+5){  //цикл для поискового поворота вала сервопривода с ультразвуковым датчиком
  dvig.write(i);
  delay(100);
  dist=dalnomer.Ranging(CM);                 // набор команд для определения минимального расстояния
  if (dist < distMem){distMem=dist; iMem=i;}  // и запоминания положения вала серводвигателя при минимальном расстоянии
  lcd.setCursor(0, 1);
  lcd.print(i*0.55);             // команды для вывода на экран состояния поиска в процентах
  lcd.setCursor(4, 1);
  lcd.print("%");}
dvig.write(iMem);    // поворот вала серводвигателя в положение с минимальным расстоянием до объекта поиска
lcd.display();        // выражения для вывода на экран фразы : я тебя нашел
lcd.clear();
lcd.print("Я Тебя нашел");
delay (3000);
regim = 3; state2=2;} // после завершения функции переменной state2 присваивается число 2, и робот переходит в режим ожидания  

void regsudba(){  // пользовательская функция, выполняющая действия в режиме игры "экран судьбы"
analogWrite(led, 0);
lcd.clear();                       // команды для вывода на экран фразы : Поднесите руку к моим глазам
lcd.print("Поднесите руку"); 
lcd.setCursor(0, 1); // курсор устанавливается на вторую строку первый символ
lcd.print("к моим глазам"); 
dist = 100;   // присвоение переменной расстояния начального значения
while  (dist > 4){  //пока расстояние до руки больше 4 выполняются выражения из тела цикла
  dist = dalnomer.Ranging(CM);}  // измеряется расстояние до руки
num = random(0, 10);  // переменной num присваивается случайное число 
lcd.clear(); // очищается экран
if (num == 0) {lcd.print("Все будет хорошо");} // в зависимости от значения переменной num на экран выводся случайный надписи (предсказания)
if (num == 1) {lcd.print("Все получится!");}
if (num == 2) {lcd.print("Удача рядом!");}
if (num == 3) {lcd.print("Вам обязательно");lcd.setCursor(0, 1); lcd.print("повезет");}
if (num == 4) {lcd.print("Добро мимо");lcd.setCursor(0, 1); lcd.print("не пройдет");}
if (num == 5) {lcd.print("У Вас Хорошее");lcd.setCursor(0, 1); lcd.print("настроение");}
if (num == 6) {lcd.print("Будет еще лучше");}
if (num == 7) {lcd.print("Ожидается");lcd.setCursor(0, 1); lcd.print("хорошая погода");}
if (num == 8) {lcd.print("Отлично, когда");lcd.setCursor(0, 1); lcd.print("все хорошо");}
if (num == 9) {lcd.print("Жизнь будет");lcd.setCursor(0, 1); lcd.print("радостной");}
delay (5000); // задержка на 5 секунд
lcd.clear();     // очистка экрана 
regim = 3; state2=3;} // после завершения функции переменной state2 присваивается число 3, и робот переходит в режим ожидания  

void reggame(){  // пользовательская функция для игры "скорость"
analogWrite(led, 0);
lcd.clear();                  // набор команд для вывода на экран фразы: Для начала игры нажмите кнопку
lcd.print("Для начала игры"); 
lcd.setCursor(0, 1); 
lcd.print("нажмите кнопку"); 
state = LOW;               // переменной нажатия кнопки присваивается начальное значение (кнопка не нажата)
  while  (state == LOW){   // пока кнопка не нажата выполняются выражения из тела цикла
  state = digitalRead(button);}   // считывается состояние кнопки
for (i=5; i>0; i--){   // запускается цикл для вывода на экран слова "Приготовлись" и обратного отсчета
  lcd.clear();  
  lcd.print("Приготовились");
  lcd.setCursor(0, 1); 
  lcd.print(i);
  delay(1000);}
tone (buzer, 3000, 1500); // звуковой сигнал на бузере после завершения обратного отсчета
i=0;  // теперь переменная i используется для подсчета количества очков
time= millis();   // засекается время
lcd.clear();      // очищается экран,
lcd.print("Количество очков");  // после чего на него выводится фраза: Количество очков
while  (i < 20){               // пока количество очков не достигло 20 выполняется цикл подсчета очков
  dist = dalnomer.Ranging(CM);
  delay (1);
  if (dist > 50) { state=1;}                   // условия для регистрации проведения одного раза рукой
  if (dist < 20 && state ==1){state =0; i=i+1;} // и засчитывания очка
  lcd.setCursor(0, 1); 
  lcd.print(i);}   // вывод на экран текущего количества очков
delay(500);
tone (buzer, 3000, 1500);  // звуковой сигнал на бузере после завершения игры
lcd.clear();  
lcd.print("Ваше время"); // вывод на экран фразы: Ваше время
lcd.setCursor(0, 1);
i= (millis()- time)/1000; // использование переменной i в третий раз для подсчета времени 
lcd.print(i);    // вывод на экран итогового значения времени, за которое набраны 20 очков
lcd.setCursor(4, 1);
lcd.print("секунд(ы)");  // вывод на экран слова: секунд(ы)
delay(3000);
regim = 3; state2=0;} // после завершения функции переменной state2 присваивается ноль, и робот переходит в режим ожидания  

void song(){ // пользовательская функция, формирующая звуковой сигнал бузера длительностью 3 секунды
tone (buzer, 2000, 3000);}


