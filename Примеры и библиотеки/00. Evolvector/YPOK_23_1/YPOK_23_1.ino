//урок 23-1 Секундомер
#define buzer A0
#define button1 A1
#define button2 A2

int SegPin[7] = {6,7,8,9,10,12,13}; //пины к которым подключен индикатор в последовательности: A,F,B,G,C,D,E
int DigPin[4] = {2,3,4,5}; // Пины к которым подключены dig выходы в последовательности: DIG4, DIg3, DIG2, DIG1
int Dot = 11; // Пин к которому подключен контакт точки DP

boolean Num[10][7] = {   // Двумерный массив каждой цифры индикатора
{1,1,1,0,1,1,1}, //0
{0,0,1,0,1,0,0}, //1
{1,0,1,1,0,1,1}, //2
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{1,1,1,1,1,1,0}}; //9

int Razryad [4]; // массив для хранения каждой цифры разряда
int i,j, sbros=1, val, state=0; // sbros изначально приравниваем к 1, что бы при первом нажатии начать отсчет с нуля.
double number,time;
void setup()
{
  for (i = 0; i < 7; ++i){ // запускаем цикл в котором перебором присваимваем необходимым выводам режим ВЫХОД
  pinMode(SegPin[i], OUTPUT);}
  for (i = 0; i < 4; ++i){ // запускаем цикл в котором перебором присваимваем необходимым выводам режим ВЫХОД
  pinMode(DigPin[i], OUTPUT);}
  pinMode(Dot, OUTPUT);
  pinMode(buzer, OUTPUT);
}
 
void loop(){
val=digitalRead(button1);//считываем состояние первой кнопки
if (val == HIGH){ //если она нажата, то
  delay(300);
  tone(buzer, 3000,200);
  state = 1-state; // меняем состояние переменной state
  if (sbros ==1){ //если была нажата клавиша сброса, то запоминаем время , что бы начать отсчет с нуля
    sbros =0;  // обнуляем сброс
    time = millis();//запоминаем текущее занчение
} }
while (state == 1){   //пока состояние переменной state не поменяется, будем выводить секунды на индикатор
  number =(millis()-time)/1000.0; //переменно присваивается значение равное количеству секунд (за минусом запомненного)
  Indikator(number,1); // запуск функции, которая выводит значение переменной с 1 знаком после запятой
  val=digitalRead(button1); // считываем состояние кнопки
  if (val == HIGH){state = 1-state; delay(200);tone(buzer, 3000,200);} // если кнопка нажата, то меняем состояние переменной state
  }
Indikator(number,1); //выводим последнее значение после выхода из цикла либо ноль если в цикл не входили.
val=digitalRead(button2); //считываем состояние кнопки 2
if (val == HIGH){sbros=1; number = 0.0;tone(buzer, 1000,200);} //если нажали кнопку 2, то сбрасываем время на ноль и меняем переменную sbros на 1
}

void Indikator(double chislo, int Razr){  // получаем из программы число и колличество знаков после запятой
chislo = chislo * pow(10,Razr); // приводим дробное число к целому
if (chislo >= 10000){chislo=9999;} //если полученной число больше 4х разрядов, то выводим 9999
  Razryad[3] = chislo/1000; // выделяем из числа цифру четвертого разряда
  Razryad[2] = (chislo-Razryad[3]*1000)/100;// выделяем из числа цифру третьего разряда
  Razryad[1] = (chislo-Razryad[3]*1000-Razryad[2]*100)/10;// выделяем из числа цифру второго разряда
  Razryad[0] = (chislo-Razryad[3]*1000-Razryad[2]*100-Razryad[1]*10); // выделяем из числа цифру первого разряда
for (j=0; j < 4; j++){   // запускаем цикл перебора разрядов
  if (Razr == j){digitalWrite(Dot,HIGH);} // Если разряд соответствует введенному количеству знаков после запятой, то ставим в этом разряде точку. Искусственно превращая число снова в дробное
 for (i = 0; i < 7; i++) { // запускаем цикл для вывода числа на текущий разряд индикатора
   digitalWrite(SegPin[i], Num[Razryad[j]][i]);} // включение нужных сегментов в соответствии с выводимой цифрой
   digitalWrite(DigPin[j],HIGH); //включаем вывод цифры на нужном разряде
   delay(1); // задержка для срабатывания запирающих транзисторов
   digitalWrite(DigPin[j],LOW); //отключаем разряд на котором вывили ццифры
   digitalWrite(Dot,LOW); //отключаем вывод точки
}}  
  

