
// Урок 8 схема 1 "Экран Судьбы"
#include <LiquidCrystalRus.h>// Подключение библиотеки LCD экрана с русскими буквами
LiquidCrystalRus lcd(3, 4, 8, 9, 10, 11);// Инициализация контактов, к которым подключен экран
int BUTTON = 13, val = 0, num =0; // Задаются необходимые переменные

void setup()
{
 lcd.begin(16, 2);// Инициализация экрана как 2х строчного с 16 символами в строке
 pinMode(BUTTON, INPUT);
randomSeed(analogRead(A5)); // инициализация генератора случайных чисел
}

void loop()
{
val = digitalRead(BUTTON); // считывание нажатия кнопки
lcd.setCursor(0, 0);  //установка курсора на первый символ в первой строке
lcd.print("Экран судьбы"); // вывод на экран надписи: Экран судьбы
lcd.setCursor(0, 1); // установка курсора на первый символ во второй строке
lcd.print("готов к работе"); // вывод на экран надписи: готов к работе
if (val == HIGH) { //если кнопка нажата, то выполняется генерация предсказания
num = random(0, 10);  // присваивается случайное число переменной num
lcd.clear(); // очистка экрана
if (num == 0) {lcd.print("Все будет хорошо");} // в зависимости от значения переменной num на экран выводятся надписи
if (num == 1) {lcd.print("Все получится!");}
if (num == 2) {lcd.print("Удача рядом!");}
if (num == 3) {lcd.print("Вам обязательно");lcd.setCursor(0, 1); lcd.print("повезет");}
if (num == 4) {lcd.print("Добро мимо");lcd.setCursor(0, 1); lcd.print("не пройдет");}
if (num == 5) {lcd.print("У Вас Хорошее");lcd.setCursor(0, 1); lcd.print("настроение");}
if (num == 6) {lcd.print("Будет еще лучше");}
if (num == 7) {lcd.print("Ожидается");lcd.setCursor(0, 1); lcd.print("хорошая погода");}
if (num == 8) {lcd.print("Отлично, когда");lcd.setCursor(0, 1); lcd.print("все хорошо");}
if (num == 9) {lcd.print("Жизнь будет");lcd.setCursor(0, 1); lcd.print("радостной");}
delay (5000); // задержка на 5 секунд
lcd.clear();    } // очистка экрана 
}
