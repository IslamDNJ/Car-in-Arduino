#include <LiquidCrystalRus.h>// Подключение библиотеки LCD экрана с русскими буквами
#define M11 5  //Присвоение константам номера пинов
#define M12 6 //M11 и М12 - пины для первого двигателя
#define M21 9 //М21 и М22 - пины для второго двигателя
#define M22 10
#define button1 2 // пины для кнопок
#define button2 13

LiquidCrystalRus lcd(3, 4, 7, 8, 11, 12);// Инициализация контактов, к которым подключен экран
int program[2][5], shag=0, i,j, val1, val2, num=0, z=0,t=0; //технические переменные и массив program в которой записываются парамметры программы (сколько секунд ехать и в каком направлении)
float time; //техническая переменная
boolean nagim=0;  //техническая переменная
const char* text[4] = {"\1\1\1\1\1 ВПЕРЕД \1\1\1\1\1", "\2\2\2\2\2 НАЗАД \2\2\2\2\2", "\3\3\3\3\3 ПРАВО \3\3\3\3\3","\4\4\4\4\4 ЛЕВО \4\4\4\4\4"}; //массив text типа "const char*" для хранения фраз текста

byte pered[8] = // массивы pered, nazad, pravo, levo битового типа(byte)- хранят данные для создания собственных символов (стрелок с направлениями)
{
  B00100,
  B01110,
  B01110,
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  B00100,
};

byte nazad[8] =
{
  B00100,
  B00100,
  B00100,
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  B00100,
};

byte pravo[8] =
{
  B01000,
  B00100,
  B00010,
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  B00000,
};
byte levo[8] =
{
  B00010,
  B00100,
  B01000,
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  B00000,
};

void setup(){
lcd.begin(16, 2);// Инициализация экрана как 2х строчного с 16 символами в строке
pinMode(button1, INPUT); //определение режимов работы выводов
pinMode(button2, INPUT);
pinMode(M11, OUTPUT);
pinMode(M12, OUTPUT);
pinMode(M21, OUTPUT);
pinMode(M22, OUTPUT);

lcd.createChar(1, pered); // создание собственных символов под номерами 1,2,3,4. Для создания символов используются битовые массивы pered, nazad, pravo, levo
lcd.createChar(2, nazad);
lcd.createChar(3, pravo);
lcd.createChar(4, levo);
}

void loop(){ // основной цикл программы
if (shag == 0){  //Если находимся на нулевом шаге (shag = 0), то запускаем приветствие
  lcd.clear();
  lcd.setCursor(16, 0);  
  lcd.print("Программирование робота");
  lcd.setCursor(20, 1);  
  lcd.print("Нажмите кнопку 2");
  for (i=0; i<39; i++){  // запускаем цикл для пролистывания всех символов текста приветствия с права на лево
    BUTTON(); // во время цикла проверяем состояние кнопок на нажатия с помощью функции BUTTON
    if (nagim==1){i=40; nagim=0;} //если произошло нажатие на кнопку (nagim =1) во время цикла, то для выхода из него сразу присваиваем переменной i максимальное значение. Переменную nagim сбрасываем на ноль.
    lcd.scrollDisplayLeft(); // пролистываем текст на один символ в лево
    delay(200);} // задержка для фиксирования текста на экране
}
if (shag == 1){menu1();} // В зависимости от значения переменной shag переключаемся на функции menu1 или menu2.
if (shag == 2){menu2();}
}

void BUTTON(){   // функция BUTTON. Используется для считывания состояния кнопок и изменения значения переменных в зависимости от этого состояния.
val1= digitalRead(button1);   // считываем состояние кнопок 1 и 2
val2 = digitalRead(button2);
if (val1 ==1 || val2==1) {nagim=1;} // если кнопка 1 ИЛИ кнопка 1 нажаты, то меняем значение переменной nagim на 1.
if (val1==1 & shag ==1){//если было нажатие на кнопку 1 И находимся на первом шаге (то есть в меню 1),
  num=num+1;  // то  увеличиваем значени переменной num в которой хранится номер действия (вперд, назад, право, лево)
  if (num > 3){num = 0;}} // если значение num превышает 3, то сбрасываем его на 0, так как в программе всего 4 действия 
if (val1==1 & shag ==2) {if (num == 2 || num == 3) { //Если была нажата кнопка 1 и находимс в меню 2 (то есть задаем время для действия), то увеличиваем значение переменной time
      time = time+0.5; if (time > 5.0){time = 0.0;}} // при этом если задаем время для действия 2 и 3 (поврот на право или на лево, то увеличиваем переменную time на 0,5 до значения не более 5.
      else {time=time+1.0;  if (time > 10){time = 0.0;}}}// если задаем время для действия 0 и 1 (езда вперед и назад), то увеличиваем переменную time на 1 до значения не более 10.
if (val2==1){shag=shag+1; if (shag > 2){shag=1;}} //Если была нажата кнопка 2, то увеличиваем переменную shag (для перехода к следующему меню) переменная шаг может иметь значение не более 2.
while (val1 ==1 || val2==1){  // следующие 3 действия необходимы для исключения ошибочного нажатия.
val1= digitalRead(button1); // при нажатии на любую кнопку программа останавливается "зависая" в цикле, пока кнопку не отпустят.
val2 = digitalRead(button2);}
}

void menu1(){ //Меню 1
lcd.clear(); // в меню 1 выбирается направление движения (вперед, назад, вправо, влево)
lcd.setCursor(3, 0); //выводится информация о меню
lcd.print("Выберите направление");
lcd.setCursor(24, 0);
lcd.print(z+1);
lcd.setCursor(4, 1);
lcd.print(text[num]); //ввыодится текст из текстового массива text. Номер элемента соответствует переменной num, которая изменяется при нажатии на кнопку 1

for (i=0; i<11; i++){ // запускаем цикл для пролистывания всех символов текста приветствия с права на лево
lcd.scrollDisplayLeft(); //пролистывание на один символ в лево
delay(200);//задержка для фиксации отображения символов
BUTTON(); //проверка нажатия кнопки
if (nagim==1){i=12;}}  //если произошло нажатие на кнопку (nagim =1) во время цикла, то для выхода из него сразу присваиваем переменной i максимальное значение. Переменную nagim НЕ сбрасываем на ноль, так как далее идет еще один цикл.
for (i=0; i<11; i++){ // запускаем цикл для пролистывания всех символов текста приветствия с лево на право
lcd.scrollDisplayRight();//пролистывание на один символ в право
delay(200);//задержка для фиксации отображения символов
if (nagim==1){i=12; nagim=0;} //если произошло нажатие на кнопку (nagim =1) во время цикла, то для выхода из него сразу присваиваем переменной i максимальное значение. Переменную nagim сбрасываем на ноль.
BUTTON();}//проверка нажатия кнопки
if (shag==2){program[t][z]=num; time=0; t=1;} //если было нажатие на кнопку 2 и как следствие переменная shag=2, то в массив program записываем номер выбранного направления num. Запись иде в ячейку [t][z]. t - в этом меню всегда равна 0, а z равно номеру шага  (всего 5 шагов). 
}

void menu2(){ // Меню шага 2
lcd.clear();
lcd.setCursor(0, 0);  
lcd.print("Задайте время");
lcd.setCursor(14, 0);  
lcd.print(z+1);
BUTTON();
lcd.setCursor(4, 1); 
lcd.print(time);
lcd.setCursor(7, 1);
lcd.print("сек.");
delay (200);
if (shag==1){program[t][z]=time; num=0; time=0; t=0; z=z+1;}
if (z > 4){num=0; time=0; t=0, z=0, shag=0; GO();}
}


void GO(){
for (i=0; i<5; i++){
   switch (program[0][i]) {
      case 0:  
        goPered(255);
        break;
      case 1:  
        goNazad(255);
        break;
      case 2:  
        goPravo(255);
        break;
      case 3:  
        goLevo(255);
        break;}
lcd.clear();
lcd.setCursor(2, 0);  
lcd.print("ПОЕХАЛИ!!!!"); 
lcd.setCursor(5, 1);  
lcd.print("Шаг");
lcd.setCursor(7, 1);  
lcd.print(i+1);
delay(program[1][i]*1000);
}
goStop();
}

int goPered(int Skorost){analogWrite(M12,LOW);
    analogWrite(M21,LOW);
    analogWrite(M11,Skorost);
    analogWrite(M22,Skorost);}
int goNazad(int Skorost){analogWrite(M11,LOW);
    analogWrite(M22,LOW); 
      analogWrite(M12,Skorost);
    analogWrite(M21,Skorost);}
int goLevo(int Skorost){analogWrite(M12,LOW);
   analogWrite(M22,LOW); 
    analogWrite(M11,Skorost);
    analogWrite(M21,Skorost);}
int goPravo(int Skorost){digitalWrite(M11,LOW);
    analogWrite(M21,LOW); 
    analogWrite(M12,Skorost);
   analogWrite(M22,Skorost);}
void goStop(){digitalWrite(M12,LOW);
    digitalWrite(M21,LOW);
    digitalWrite(M11,LOW);
    digitalWrite(M22,LOW);}
